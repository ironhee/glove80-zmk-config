#include <behaviors.dtsi>
#include <dt-bindings/zmk/keys.h>
#include <dt-bindings/zmk/bt.h>
#include <dt-bindings/zmk/ext_power.h>
#include <dt-bindings/zmk/outputs.h>
#include <dt-bindings/zmk/rgb.h>
#include "./position.h"

// layers
#define DEFT 0
#define NAVI 1
#define NUMB 2
#define SYMB 3
#define MAGI 4

// Helpers
#define WRAP_QUOTE(X) #X
#define IRONHEE_MACRO(NAME, ...) \
    NAME: NAME { \
        label = WRAP_QUOTE(MACRO_ ## NAME); \
        compatible = "zmk,behavior-macro"; \
        #binding-cells = <0>; \
        wait-ms = <1>; \
        tap-ms = <1>; \
        bindings = __VA_ARGS__; \
    };
#define IRONHEE_MORP_SHIFT(NAME, BINDING_BASE, BINDING_MORP) \
    NAME: NAME { \
        compatible = "zmk,behavior-mod-morph"; \
        label = WRAP_QUOTE(MORP_SHIFT_ ## NAME); \
        #binding-cells = <0>; \
        bindings = <BINDING_BASE>, <BINDING_MORP>; \
        mods = <(MOD_LSFT|MOD_RSFT)>; \
    };
#define IRONHEE_COMBO(NAME, KEY_POSITIONS, BINDINGS) \
    combo_ ## NAME { \
        timeout-ms = <32>; \
        key-positions = <KEY_POSITIONS>; \
        bindings = <BINDINGS>; \
    };

&sk {
    release-after-ms = <200>;
    quick-release;
};

&lt {
    flavor = "balanced";
    tapping-term-ms = <200>;
    quick-tap-ms = <175>;
};

&mt {
    tapping-term-ms = <280>;
    quick-tap-ms = <175>;
};

/ {
    behaviors {
        magic: magic_hold_tap {
            compatible = "zmk,behavior-hold-tap";
            label = "MAGI_HOLD_TAP";
            #binding-cells = <2>;
            flavor = "tap-preferred";
            tapping-term-ms = <200>;
            bindings = <&mo>, <&rgb_ug_status_macro>;
        };

        // Hold Tap
        lmt: left_mod_tap {
            compatible = "zmk,behavior-hold-tap";
            label = "left_mod_tap";
            flavor = "tap-preferred";
            tapping-term-ms = <280>;
            quick-tap-ms = <175>;
            require-prior-idle-ms = <150>;
            hold-trigger-key-positions = <R1_X R2_X R3_X R4_X R5_X R6_X RT_X LT_X>;
            hold-trigger-on-release;
            #binding-cells = <2>;
            bindings = <&kp>, <&kp>;
        };
        rmt: right_mod_tap {
            compatible = "zmk,behavior-hold-tap";
            label = "right_mod_tap";
            flavor = "tap-preferred";
            tapping-term-ms = <280>;
            quick-tap-ms = <175>;
            require-prior-idle-ms = <150>;
            hold-trigger-key-positions = <L1_X L2_X L3_X L4_X L5_X L6_X LT_X RT_X>;
            hold-trigger-on-release;
            #binding-cells = <2>;
            bindings = <&kp>, <&kp>;
        };
        lt_m_comma: lt_m_comma {
            compatible = "zmk,behavior-hold-tap";
            label = "lt_m_comma";
            flavor = "tap-preferred";
            tapping-term-ms = <200>;
            #binding-cells = <2>;
            bindings = <&mo>, <&m_comma>;
        };
        // Morp Shift
        IRONHEE_MORP_SHIFT(m_comma, &kp COMMA, &kp QMARK)
        IRONHEE_MORP_SHIFT(m_dot,   &kp DOT,   &kp EXCL)
        IRONHEE_MORP_SHIFT(m_flsh,  &kp FSLH,  &kp BSLH)
        IRONHEE_MORP_SHIFT(m_lpar,  &kp LPAR,  &kp LT)
        IRONHEE_MORP_SHIFT(m_rpar,  &kp RPAR,  &kp GT)
    };

    macros {
        IRONHEE_MACRO(rgb_ug_status_macro, <&rgb_ug RGB_STATUS>)
        IRONHEE_MACRO(bt_0, <&out OUT_BLE>, <&bt BT_SEL 0>)
        IRONHEE_MACRO(bt_1, <&out OUT_BLE>, <&bt BT_SEL 1>)
        IRONHEE_MACRO(bt_2, <&out OUT_BLE>, <&bt BT_SEL 2>)
        IRONHEE_MACRO(bt_3, <&out OUT_BLE>, <&bt BT_SEL 3>)
        IRONHEE_MACRO(scr_cap, <&macro_press &kp LSHFT &kp LCMD>, <&macro_tap &kp N4>, <&macro_release &kp LSHFT &kp LCMD>)
        IRONHEE_MACRO(scr_rec, <&macro_press &kp LSHFT &kp LCMD>, <&macro_tap &kp N5>, <&macro_release &kp LSHFT &kp LCMD>)
        IRONHEE_MACRO(emoji, <&macro_press &kp LCTRL &kp LCMD>, <&macro_tap &kp SPACE>, <&macro_release &kp LCTRL &kp LCMD>)
        IRONHEE_MACRO(app_l, <&macro_press &kp LCMD>, <&macro_tap &kp TAB>, <&macro_release &kp LCMD>)
        IRONHEE_MACRO(app_r, <&macro_press &kp LCMD &kp LSHFT>, <&macro_tap &kp TAB>, <&macro_release &kp LCMD &kp LSHFT>)
        IRONHEE_MACRO(win_l, <&macro_press &kp LCTRL>, <&macro_tap &kp LEFT>, <&macro_release &kp LCTRL>)
        IRONHEE_MACRO(win_r, <&macro_press &kp LCTRL>, <&macro_tap &kp RIGHT>, <&macro_release &kp LCTRL>)
        IRONHEE_MACRO(win_u, <&macro_press &kp LCTRL>, <&macro_tap &kp UP>, <&macro_release &kp LCTRL>)
        IRONHEE_MACRO(win_d, <&macro_press &kp LCTRL>, <&macro_tap &kp DOWN>, <&macro_release &kp LCTRL>)
    };

    combos {
        compatible = "zmk,combos";
        // Left Hand Combo
        IRONHEE_COMBO(l_tab,       L4_4 L4_3     , &lmt LA(LCMD) TAB)
        IRONHEE_COMBO(l_ret,            L4_3 L4_2, &lmt LS(LCMD) RET)
        IRONHEE_COMBO(l_esc,       L4_4      L4_2, &lmt LA(LSHFT) ESC)
        IRONHEE_COMBO(l_del,       L5_4 L5_3     , &kp DEL)
        IRONHEE_COMBO(l_bspc,           L5_3 L5_2, &kp BSPC)
        // Right Hand Combos
        IRONHEE_COMBO(r_lang,      R4_2 R4_3     , &rmt LS(LCMD) LC(SPACE))
        IRONHEE_COMBO(r_caps,           R4_3 R4_4, &rmt LA(LCMD) CAPS)
    };

    keymap {
        compatible = "zmk,keymap";

        deft_layer {
            bindings = <
            &kp F1        &kp F2      &kp F3       &kp F4      &kp F5                                                      /* */                                          &kp F6       &kp F7             &kp F8      &kp F9          &kp F10
            &kp F11       &kp N1      &kp N2       &kp N3      &kp N4       &kp N5                                         /* */                                   &kp N6 &kp N7       &kp N8             &kp N9      &kp N0          &kp F12
            &kp GRAVE     &kp Q       &kp W        &kp E       &kp R        &kp T                                          /* */                                   &kp Y  &kp U        &kp I              &kp O       &kp P           &emoji
            &kp EQUAL     &lmt LCTRL A &lmt LALT S &lmt LCMD D &lmt LSHFT F &kp G                                          /* */                                   &kp H  &rmt LSHFT J &rmt LCMD K        &rmt LALT L &rmt LCTRL APOS &kp SEMI
            &kp UNDER     &kp Z       &kp X        &kp C       &lt SYMB V   &kp B  &sk LCMD       &sk LCTRL    &kp C_PP    /* */ &kp K_VOL_UP &kp COLON &kp ESC    &kp N  &lt SYMB M   &lt_m_comma NUMB 0 &m_dot      &m_flsh         &kp COLON
            &magic MAGI 0 &kp LT      &kp LBKT     &kp RBKT    &kp GT              &lt NAVI SPACE &mt LCMD RET &kp C_MUTE  /* */ &kp K_VOL_DN &kp BSPC  &sk LSHIFT        &m_lpar      &kp LBKT           &kp RBKT    &m_rpar        &magic MAGI 0
            >;
        };

        navi_layer {
            bindings = <
            &trans &trans    &trans   &trans   &trans                                /* */                                   &trans       &trans   &trans        &trans        &trans
            &trans &trans    &trans   &trans   &trans    &trans                      /* */                      &trans       &trans       &trans   &trans        &trans        &trans
            &trans &trans    &trans   &trans   &trans    &trans                      /* */                      &trans       &kp LA(LEFT) &kp UP   &kp LA(RIGHT) &trans        &trans
            &trans &kp LCTRL &kp LALT &kp LCMD &kp LSHFT &trans                      /* */                      &kp LG(LEFT) &kp LEFT     &kp DOWN &kp RIGHT     &kp LG(RIGHT) &trans
            &trans &win_d    &win_u   &win_l   &win_r    &trans &trans &trans &trans /* */ &trans &trans &trans &trans       &trans       &trans   &trans        &trans        &trans
            &trans &trans    &trans   &trans   &trans           &trans &trans &trans /* */ &trans &trans &trans              &trans       &trans   &trans        &trans        &trans
            >;
        };

        numb_layer {
            bindings = <
            &trans &trans &trans &trans &trans                             /* */                               &trans    &trans    &trans   &trans   &trans
            &trans &trans &trans &trans &trans &trans                      /* */                        &trans &trans    &trans    &trans   &trans   &trans
            &trans &kp N0 &kp N7 &kp N8 &kp N9 &trans                      /* */                        &trans &trans    &trans    &trans   &trans   &trans
            &trans &kp N0 &kp N4 &kp N5 &kp N6 &trans                      /* */                        &trans &trans    &trans    &trans   &trans   &trans
            &trans &kp N0 &kp N1 &kp N2 &kp N3 &trans &trans &trans &trans /* */ &trans &trans &trans   &trans &kp LSHFT &kp LCMD &kp LALT &kp LCTRL &trans
            &trans &trans &trans &trans &trans        &trans &trans &trans /* */ &trans &trans &kp LCMD        &trans    &trans    &trans   &trans   &trans
            >;
        };

        symb_layer {
            bindings = <
            &trans &trans           &trans         &trans         &trans                                         /* */                               &trans          &trans         &trans         &trans           &trans
            &trans &trans           &trans         &trans         &trans          &trans                         /* */                      &trans   &trans          &trans         &trans         &trans           &trans
            &trans &trans           &kp LT         &kp GT         &kp PRCNT       &kp CARET                      /* */                      &trans   &kp GRAVE       &kp LBKT       &kp RBKT       &kp BSLH         &trans
            &trans &kp EXCL         &kp MINUS      &kp PLUS       &kp EQUAL       &kp COLON                      /* */                      &kp AT   &kp UNDER       &kp LPAR       &kp RPAR       &kp SEMI         &trans
            &trans &lmt LCTRL QMARK &lmt LALT FSLH &lmt LCMD STAR &lmt LSHFT PIPE &kp AMPS  &trans &trans &trans /* */ &trans &trans &trans &kp HASH &rmt LSHFT DLLR &rmt LCMD LBRC &rmt LALT RBRC &rmt LCTRL TILDE &trans
            &trans &trans           &trans         &trans         &trans                    &trans &trans &trans /* */ &trans &trans &trans          &trans          &trans         &trans         &trans           &trans
            >;
        };

        magi_layer {
            bindings = <
            &bt BT_CLR  &none           &none           &none           &none                                                    /* */                         &none &none &none &none &bt BT_CLR_ALL
            &none       &none           &none           &none           &none           &none                                    /* */                   &none &none &none &none &none &none
            &none       &rgb_ug RGB_SPI &rgb_ug RGB_SAI &rgb_ug RGB_HUI &rgb_ug RGB_BRI &rgb_ug RGB_TOG                          /* */                   &none &none &none &none &none &none
            &bootloader &rgb_ug RGB_SPD &rgb_ug RGB_SAD &rgb_ug RGB_HUD &rgb_ug RGB_BRD &rgb_ug RGB_EFF                          /* */                   &none &none &none &none &none &bootloader
            &sys_reset  &none           &none           &none           &none           &none           &bt_2 &bt_3 &none        /* */ &none &none &none &none &none &none &none &none &sys_reset
            &none       &none           &none           &none           &none                           &bt_0 &bt_1 &out OUT_USB /* */ &none &none &none       &none &none &none &none &none
            >;
        };
    };
};
